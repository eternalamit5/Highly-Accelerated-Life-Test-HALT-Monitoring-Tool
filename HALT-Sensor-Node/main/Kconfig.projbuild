## HALT-Sensor-Node/main/Kconfig.projbuild
```kconfig
menu "Matilda Configuration"

    config ESP_WIFI_SSID
        string "WiFi SSID"
        default "biba-testbed"
        help
            SSID (network name) for the example to connect to.

    config ESP_WIFI_PASSWORD
        string "WiFi Password"
        default "she26ghr01"
        help
            WiFi password (WPA or WPA2) for the example to use.

    config ESP_MAXIMUM_RETRY
        int "Maximum retry for WiFi"
        default 5
        help
            Set the Maximum retry to avoid station reconnecting to the AP unlimited when the AP is really inexistent.
            
    config BROKER_URL
        string "Broker URL for MQTT"
        default "mqtt://192.168.0.102:1883"
        help
            URL of the broker to connect to
            
    config NETWORK_ID
        string "Network ID"
        default "5678"
        help
            Network ID
            
    config DEVICE_ID
        string "Device ID"
        default "1234"
        help
            Device ID             
endmenu
```
